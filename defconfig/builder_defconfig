## defconfig/builder_defconfig
```kconfig
# nyaastrap configuration file.
CONFIG_BUILDDIR=/out
CONFIG_CLIB_GLIBC=y
CONFIG_TLS_OPENSSL=y
CONFIG_CORE_BUSYBOX=y
CONFIG_BINARY=n
CONFIG_CC_GCC=y
CONFIG_EXTRA_PACKAGES="gmake"
```
